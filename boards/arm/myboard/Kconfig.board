## boards/arm/myboard/Kconfig.board
```kconfig
# Copyright (c) 2022 Toost Solutions
# SPDX-License-Identifier: Apache-2.0

config BOARD_MYBOARD
	bool "myboard Board"
	depends on SOC_STM32U585XX
```

## boards/arm/myboard/Kconfig.defconfig
```kconfig
# Copyright (c) 2021 STMicroelectronics
# SPDX-License-Identifier: Apache-2.0

if BOARD_MYBOARD

config BOARD
	default "myboard"

config SPI_STM32_INTERRUPT
	default y
	depends on SPI

# Get flash configuration for NS image from dts flash partition
config USE_DT_CODE_PARTITION
	default y if TRUSTED_EXECUTION_NONSECURE

# LPTIM clocked by LSE, force tick freq to 4096 for tick accuracy
config SYS_CLOCK_TICKS_PER_SEC
	default 4096 if STM32_LPTIM_TIMER

endif # BOARD_MYBOARD
```

## manifest/west.yml
```yaml
# West manifest file, inspired by T2 and T3 topologies. More info here:
# https://docs.zephyrproject.org/latest/develop/west/workspaces.html#topologies-supported
manifest:
  remotes:
    - name: upstream
      url-base: https://github.com/zephyrproject-rtos
  projects:
    - name: zephyr
      remote: upstream
      revision: v3.5-branch
      west-commands: scripts/west-commands.yml
      import:
        name-allowlist:
          # Add projects/modules that need to be version tracked by
          # zephyr/west.yml here. If a project/module needs to have a
          # fixed version, they can be added to the list of projects
          # defined above
          - hal_stm32
          - hal_st
          - cmsis
  self:
    path: manifest
    west-commands: scripts/west-commands.yml
```

## manifest_dir/west.yml
```yaml
# West manifest file, inspired by T2 and T3 topologies. More info here:
# https://docs.zephyrproject.org/latest/develop/west/workspaces.html#topologies-supported
manifest:
  remotes:
    - name: upstream
      url-base: https://github.com/zephyrproject-rtos
    - name: memfault
      url-base: https://github.com/memfault
  projects:
    - name: zephyr
      remote: upstream
      revision: v3.2.0
      west-commands: scripts/west-commands.yml
      import:
        name-allowlist:
          # Add projects/modules that need to be version tracked by
          # zephyr/west.yml here. If a project/module needs to have a
          # fixed version, they can be added to the list of projects
          # defined above
          - hal_stm32
          - cmsis
          - mbedtls
    - name: memfault-firmware-sdk
      remote: memfault
      revision: 0.34.0
      path: modules/lib/memfault-firmware-sdk
  self:
    path: manifest_dir
    west-commands: scripts/west-commands.yml
```
